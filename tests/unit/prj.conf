## CMakeLists.txt
```
# SPDX-License-Identifier: Apache-2.0
# Zephyr ztest unit tests for the board-independent modules in ../../src.
# They run on the PC as a normal program (native_sim), no board needed.
cmake_minimum_required(VERSION 3.20.0)

find_package(Zephyr REQUIRED HINTS $ENV{ZEPHYR_BASE})
project(vibration_unit_tests)

set(APP_SRC ${CMAKE_CURRENT_SOURCE_DIR}/../../src)

target_include_directories(app PRIVATE ${APP_SRC})
target_sources(app PRIVATE
	src/test_accel_stats.c
	src/test_vib_fft.c
	src/test_ble_fmt.c
	src/test_ble_cmd.c
	${APP_SRC}/accel_stats.c
	${APP_SRC}/vib_fft.c
	${APP_SRC}/ble_fmt.c
	${APP_SRC}/ble_cmd.c)
```

## prj.conf
```kconfig
CONFIG_ZTEST=y

# vib_fft uses the same CMSIS-DSP real FFT as the firmware
CONFIG_CMSIS_DSP=y
CONFIG_CMSIS_DSP_TRANSFORM=y
```

## src/test_accel_stats.c
```c
/* ztest suite for src/accel_stats.c (same checks as tests/host/test_accel_stats.c) */
#include <zephyr/ztest.h>
#include <stdint.h>
#include "accel_stats.h"

ZTEST_SUITE(accel_stats, NULL, NULL, NULL, NULL, NULL);

ZTEST(accel_stats, test_isqrt_0_to_4)
{
	zassert_equal(accel_isqrt64(0), 0);
	zassert_equal(accel_isqrt64(1), 1);
	zassert_equal(accel_isqrt64(2), 1);
	zassert_equal(accel_isqrt64(3), 1);
	zassert_equal(accel_isqrt64(4), 2);
}

ZTEST(accel_stats, test_isqrt_exact_squares_and_neighbours)
{
	for (uint64_t r = 0; r < 200000; r += 7) {
		zassert_equal(accel_isqrt64(r * r), r, "isqrt(%llu^2)", (unsigned long long)r);
		if (r > 0) {
			zassert_equal(accel_isqrt64(r * r - 1), r - 1, "isqrt(%llu^2 - 1)",
				      (unsigned long long)r);
		}
	}
}

ZTEST(accel_stats, test_isqrt_max_input)
{
	zassert_equal(accel_isqrt64(UINT64_MAX), 4294967295u, "isqrt(2^64 - 1) = 2^32 - 1");
}

ZTEST(accel_stats, test_isqrt_is_floor_on_a_spread_up_to_2_pow_40)
{
	for (uint64_t v = 1; v < (1ull << 40); v = v * 3 + 1) {
		uint64_t r = accel_isqrt64(v);

		zassert_true(r * r <= v && (r + 1) * (r + 1) > v, "v = %llu", (unsigned long long)v);
	}
}

ZTEST(accel_stats, test_magnitude_known_vectors)
{
	int32_t g[3] = { 0, 0, 9807 };
	int32_t t[3] = { 3000, -4000, 0 };
	int32_t n[3] = { -9807, 0, 0 };

	zassert_equal(accel_magnitude(g), 9807, "1 g lying flat");
	zassert_equal(accel_magnitude(t), 5000, "3-4-5 triangle, sign ignored");
	zassert_equal(accel_magnitude(n), 9807, "negative axis");
}

ZTEST(accel_stats, test_magnitude_16g_all_axes_does_not_overflow)
{
	int32_t big[3] = { 156900, 156900, 156900 };

	/* floor(sqrt(3 * 156900^2)), computed in double precision on the PC */
	zassert_equal(accel_magnitude(big), 271758);
}

ZTEST(accel_stats, test_mean_of_empty_window_is_refused)
{
	struct accel_stats s;
	int32_t mean[3];

	accel_stats_reset(&s);
	zassert_equal(accel_stats_mean(&s, mean), -1);
}

ZTEST(accel_stats, test_mean_count_and_extremes_of_alternating_samples)
{
	struct accel_stats s;
	int32_t mean[3];

	accel_stats_reset(&s);
	for (int i = 0; i < 100; i++) {
		int32_t v[3] = { (i % 2) ? 20 : -20, 5, 9807 + ((i % 2) ? 100 : -100) };

		accel_stats_add(&s, v);
	}
	zassert_equal(accel_stats_mean(&s, mean), 0);
	zassert_equal(mean[0], 0);
	zassert_equal(mean[1], 5);
	zassert_equal(mean[2], 9807);
	zassert_equal(s.n, 100);
	zassert_equal(s.mag_min, accel_magnitude((int32_t[3]){ -20, 5, 9707 }));
	zassert_equal(s.mag_max, accel_magnitude((int32_t[3]){ 20, 5, 9907 }));
}

ZTEST(accel_stats, test_negative_mean_truncates_toward_zero)
{
	struct accel_stats s;
	int32_t mean[3];
	int32_t extra[3] = { -8, -8, -8 };

	accel_stats_reset(&s);
	for (int i = 0; i < 3; i++) {
		int32_t v[3] = { -7, -7, -7 };

		accel_stats_add(&s, v);
	}
	accel_stats_add(&s, extra);
	accel_stats_mean(&s, mean);
	zassert_equal(mean[0], -7, "-29/4 truncates to -7, got %d", (int)mean[0]);
}

ZTEST(accel_stats, test_100000_samples_at_16g_do_not_overflow_the_sums)
{
	struct accel_stats s;
	int32_t mean[3];
	int32_t big[3] = { 156900, 156900, 156900 };

	accel_stats_reset(&s);
	for (int i = 0; i < 100000; i++) {
		accel_stats_add(&s, big);
	}
	accel_stats_mean(&s, mean);
	zassert_equal(mean[0], 156900);
	zassert_equal(s.n, 100000);
}
```

## src/test_ble_cmd.c
```c
/* ztest suite for src/ble_cmd.c (same checks as tests/host/test_ble_cmd.c) */
#include <zephyr/ztest.h>
#include "ble_cmd.h"

static struct ble_cmd c;

static void fresh(void *unused)
{
	ARG_UNUSED(unused);
	ble_cmd_init(&c);
}

ZTEST_SUITE(ble_cmd, NULL, NULL, fresh, NULL, NULL);

ZTEST(ble_cmd, test_no_key_nothing_happens)
{
	zassert_equal(ble_cmd_feed(&c, -1, 0), BLE_CMD_NONE);
}

ZTEST(ble_cmd, test_y_alone_does_not_unpair)
{
	zassert_equal(ble_cmd_feed(&c, 'Y', 10), BLE_CMD_NONE);
}

ZTEST(ble_cmd, test_random_keys_are_ignored_when_not_armed)
{
	zassert_equal(ble_cmd_feed(&c, 'x', 20), BLE_CMD_NONE);
}

ZTEST(ble_cmd, test_u_then_y_unpairs_and_then_disarms)
{
	zassert_equal(ble_cmd_feed(&c, 'U', 100), BLE_CMD_ARMED);
	zassert_equal(ble_cmd_feed(&c, 'Y', 200), BLE_CMD_UNPAIR);
	zassert_equal(ble_cmd_feed(&c, 'Y', 300), BLE_CMD_NONE, "Y again does nothing");
}

ZTEST(ble_cmd, test_lower_case_works_too)
{
	zassert_equal(ble_cmd_feed(&c, 'u', 1000), BLE_CMD_ARMED);
	zassert_equal(ble_cmd_feed(&c, 'y', 1100), BLE_CMD_UNPAIR);
}

ZTEST(ble_cmd, test_any_other_key_cancels)
{
	zassert_equal(ble_cmd_feed(&c, 'U', 2000), BLE_CMD_ARMED);
	zassert_equal(ble_cmd_feed(&c, 'n', 2100), BLE_CMD_CANCELLED);
	zassert_equal(ble_cmd_feed(&c, 'Y', 2200), BLE_CMD_NONE, "Y afterwards does nothing");
}

ZTEST(ble_cmd, test_enter_between_u_and_y_is_ignored)
{
	zassert_equal(ble_cmd_feed(&c, 'U', 3000), BLE_CMD_ARMED);
	zassert_equal(ble_cmd_feed(&c, '\r', 3100), BLE_CMD_NONE);
	zassert_equal(ble_cmd_feed(&c, '\n', 3200), BLE_CMD_NONE);
	zassert_equal(ble_cmd_feed(&c, 'Y', 3300), BLE_CMD_UNPAIR);
}

ZTEST(ble_cmd, test_y_just_inside_the_window_still_confirms)
{
	zassert_equal(ble_cmd_feed(&c, 'U', 4000), BLE_CMD_ARMED);
	zassert_equal(ble_cmd_feed(&c, -1, 4000 + BLE_CMD_CONFIRM_MS - 1), BLE_CMD_NONE);
	zassert_equal(ble_cmd_feed(&c, 'Y', 4000 + BLE_CMD_CONFIRM_MS - 1), BLE_CMD_UNPAIR);
}

ZTEST(ble_cmd, test_silence_times_out_and_is_reported_once)
{
	zassert_equal(ble_cmd_feed(&c, 'U', 5000), BLE_CMD_ARMED);
	zassert_equal(ble_cmd_feed(&c, -1, 5000 + BLE_CMD_CONFIRM_MS), BLE_CMD_TIMEOUT);
	zassert_equal(ble_cmd_feed(&c, -1, 5000 + BLE_CMD_CONFIRM_MS + 100), BLE_CMD_NONE);
}

ZTEST(ble_cmd, test_a_late_y_does_not_unpair)
{
	zassert_equal(ble_cmd_feed(&c, 'U', 6000), BLE_CMD_ARMED);
	zassert_equal(ble_cmd_feed(&c, 'Y', 6000 + BLE_CMD_CONFIRM_MS), BLE_CMD_NONE);
	zassert_equal(ble_cmd_feed(&c, 'Y', 6000 + BLE_CMD_CONFIRM_MS + 1), BLE_CMD_NONE);
}

ZTEST(ble_cmd, test_a_second_u_restarts_the_window)
{
	zassert_equal(ble_cmd_feed(&c, 'U', 7000), BLE_CMD_ARMED);
	zassert_equal(ble_cmd_feed(&c, 'U', 11000), BLE_CMD_ARMED);
	zassert_equal(ble_cmd_feed(&c, 'Y', 15500), BLE_CMD_UNPAIR);
}

ZTEST(ble_cmd, test_millisecond_counter_wrap_around)
{
	zassert_equal(ble_cmd_feed(&c, 'U', 0xFFFFFF00u), BLE_CMD_ARMED);
	zassert_equal(ble_cmd_feed(&c, 'Y', 0x00000064u), BLE_CMD_UNPAIR, "Y just after 2^32");
}

ZTEST(ble_cmd, test_timeout_also_works_across_the_wrap)
{
	zassert_equal(ble_cmd_feed(&c, 'U', 0xFFFFFF00u), BLE_CMD_ARMED);
	zassert_equal(ble_cmd_feed(&c, -1, 0x00001500u), BLE_CMD_TIMEOUT);
}
```

## src/test_ble_fmt.c
```c
/* ztest suite for src/ble_fmt.c (same checks as tests/host/test_ble_fmt.c) */
#include <zephyr/ztest.h>
#include <math.h>
#include <string.h>
#include "ble_fmt.h"

ZTEST_SUITE(ble_fmt, NULL, NULL, NULL, NULL, NULL);

static unsigned int le16(const uint8_t *p)
{
	return (unsigned int)p[0] | ((unsigned int)p[1] << 8);
}

static struct vib_result res(int active, float f, float a, float rms)
{
	struct vib_result r = { .rms = rms, .freq_hz = f, .amp = a, .peak_bin = 0, .active = active != 0 };

	return r;
}

ZTEST(ble_fmt, test_measurement_bytes_and_byte_order)
{
	uint8_t m[BLE_MEAS_LEN];
	struct vib_result r = res(1, 24.56f, 0.512f, 0.371f);

	ble_meas_encode(&r, 0x1234, m);
	zassert_equal(m[0], 1, "flags: vibrating");
	zassert_equal(le16(&m[1]), 246, "24.56 Hz in 0.1 Hz units");
	zassert_equal(le16(&m[3]), 512, "amplitude in milli-m/s^2");
	zassert_equal(le16(&m[5]), 371, "rms in milli-m/s^2");
	zassert_equal(le16(&m[7]), 0x1234, "sequence number");
	zassert_equal(m[1], 0xF6, "little-endian: low byte first");
	zassert_equal(m[2], 0x00);
	zassert_equal(m[7], 0x34);
	zassert_equal(m[8], 0x12);
}

ZTEST(ble_fmt, test_summary_text_when_vibrating)
{
	char t[BLE_TEXT_MAX + 1];
	struct vib_result r = res(1, 24.56f, 0.512f, 0.371f);

	ble_text_format(&r, t);
	zassert_str_equal(t, "24.6Hz 0.51 0.37");
}

ZTEST(ble_fmt, test_still_sends_zero_frequency_and_amplitude_but_keeps_rms)
{
	uint8_t m[BLE_MEAS_LEN];
	char t[BLE_TEXT_MAX + 1];
	struct vib_result r = res(0, 33.0f, 0.2f, 0.0254f);

	ble_meas_encode(&r, 7, m);
	zassert_equal(m[0], 0);
	zassert_equal(le16(&m[1]), 0);
	zassert_equal(le16(&m[3]), 0);
	zassert_equal(le16(&m[5]), 25);
	ble_text_format(&r, t);
	zassert_str_equal(t, "still rms 0.025");
}

ZTEST(ble_fmt, test_rounding)
{
	char t[BLE_TEXT_MAX + 1];
	struct vib_result r = res(1, 2.94f, 3.3906f, 2.5149f);

	ble_text_format(&r, t);
	zassert_str_equal(t, "2.9Hz 3.39 2.51");
}

ZTEST(ble_fmt, test_worst_real_case_fits_20_bytes)
{
	char t[BLE_TEXT_MAX + 1];
	struct vib_result r = res(1, 199.96f, 39.239f, 39.239f);
	size_t n = ble_text_format(&r, t);

	zassert_str_equal(t, "200.0Hz 39.24 39.24");
	zassert_true(n <= BLE_TEXT_MAX, "%zu bytes", n);
}

ZTEST(ble_fmt, test_absurd_values_are_clamped)
{
	uint8_t m[BLE_MEAS_LEN];
	char t[BLE_TEXT_MAX + 1];
	struct vib_result r = res(1, 1e9f, 1e9f, 1e9f);
	size_t n = ble_text_format(&r, t);

	ble_meas_encode(&r, 0, m);
	zassert_true(n <= BLE_TEXT_MAX, "%zu bytes", n);
	zassert_equal(le16(&m[1]), 65535);
	zassert_equal(le16(&m[3]), 65535);
}

ZTEST(ble_fmt, test_nan_and_negatives_become_zero)
{
	uint8_t m[BLE_MEAS_LEN];
	char t[BLE_TEXT_MAX + 1];
	struct vib_result r = res(1, NAN, -1.0f, -0.5f);

	ble_meas_encode(&r, 0, m);
	ble_text_format(&r, t);
	zassert_equal(le16(&m[1]), 0);
	zassert_equal(le16(&m[3]), 0);
	zassert_equal(le16(&m[5]), 0);
	zassert_str_equal(t, "0.0Hz 0.00 0.00");
}

ZTEST(ble_fmt, test_still_text_clamps_at_9_999)
{
	char t[BLE_TEXT_MAX + 1];
	struct vib_result r = res(0, 0, 0, 9.9999f);
	size_t n = ble_text_format(&r, t);

	zassert_str_equal(t, "still rms 9.999");
	zassert_true(n <= BLE_TEXT_MAX);
}
```

## src/test_vib_fft.c
```c
/*
 * ztest suites for src/vib_fft.c (same checks as tests/host/test_vib_fft.c),
 * run against the CMSIS-DSP that Zephyr itself builds.
 *
 * Two suites because "refuses to run before init" can only be observed once:
 * Zephyr sorts suites by name, so vib_fft_1_before_init runs before
 * vib_fft_2_analysis (which initialises the FFT in its setup).
 *
 * Noise comes from a small deterministic generator so the results do not
 * depend on the C library's rand().
 */
#include <zephyr/ztest.h>
#include <math.h>
#include <stdint.h>
#include "vib_fft.h"

#define TWO_PI 6.28318530717958647692f

static float ax[3][VIB_N];
static const float *const axes[3] = { ax[0], ax[1], ax[2] };

static const float FS = 400.0f;

static void clear_block(void)
{
	for (int a = 0; a < 3; a++) {
		for (int i = 0; i < VIB_N; i++) {
			ax[a][i] = 0.0f;
		}
	}
	for (int i = 0; i < VIB_N; i++) {
		ax[2][i] = 9.81f;                  /* gravity on z, as when lying flat */
	}
}

static void add_sine(int axis, float f, float amp, float fs, float phase)
{
	for (int i = 0; i < VIB_N; i++) {
		ax[axis][i] += amp * sinf(TWO_PI * f * (float)i / fs + phase);
	}
}

static uint32_t rng_state = 1;

static void seed(uint32_t s)
{
	rng_state = s ? s : 1;
}

static float frand(void)               /* xorshift32, uniform in [-1, 1] */
{
	rng_state ^= rng_state << 13;
	rng_state ^= rng_state >> 17;
	rng_state ^= rng_state << 5;
	return (float)(rng_state >> 8) / (float)(1u << 24) * 2.0f - 1.0f;
}

static void add_noise(float level)
{
	for (int a = 0; a < 3; a++) {
		for (int i = 0; i < VIB_N; i++) {
			ax[a][i] += level * frand();
		}
	}
}

/* ---------------------------------------------------------------- before init */
ZTEST_SUITE(vib_fft_1_before_init, NULL, NULL, NULL, NULL, NULL);

ZTEST(vib_fft_1_before_init, test_refuses_to_run_before_init)
{
	struct vib_result r;

	clear_block();
	zassert_equal(vib_fft_analyse(axes, VIB_N, FS, 2.0f, 0.05f, &r), VIB_ERR_INIT);
}

/* ---------------------------------------------------------------- analysis */
static void *init_fft(void)
{
	zassert_equal(vib_fft_init(), VIB_OK, "init (CMSIS-DSP rfft, 512 points)");
	return NULL;
}

ZTEST_SUITE(vib_fft_2_analysis, NULL, init_fft, NULL, NULL, NULL);

ZTEST(vib_fft_2_analysis, test_12p5_hz_on_z_on_top_of_gravity)
{
	struct vib_result r;

	clear_block();
	add_sine(2, 12.5f, 1.0f, FS, 0.3f);                 /* exactly on bin 16 */
	vib_fft_analyse(axes, VIB_N, FS, 2.0f, 0.05f, &r);
	zassert_true(fabsf(r.freq_hz - 12.5f) < 0.02f, "freq %.3f Hz", (double)r.freq_hz);
	zassert_true(fabsf(r.amp - 1.0f) < 0.02f, "amp %.3f", (double)r.amp);
	zassert_true(r.active);
}

ZTEST(vib_fft_2_analysis, test_37p3_hz_between_bins_on_x)
{
	struct vib_result r;

	clear_block();
	add_sine(0, 37.3f, 0.5f, FS, 1.0f);
	vib_fft_analyse(axes, VIB_N, FS, 2.0f, 0.05f, &r);
	zassert_true(fabsf(r.freq_hz - 37.3f) < 0.05f, "freq %.3f Hz", (double)r.freq_hz);
	zassert_true(fabsf(r.amp - 0.5f) < 0.015f, "amp %.3f", (double)r.amp);
}

ZTEST(vib_fft_2_analysis, test_sweep_3_to_190_hz_on_all_three_axes)
{
	struct vib_result r;
	float worst_f = 0, worst_a = 0;

	for (float f = 3.0f; f < 190.0f; f += 1.37f) {
		clear_block();
		add_sine((int)(f) % 3, f, 0.8f, FS, f);
		vib_fft_analyse(axes, VIB_N, FS, 2.0f, 0.05f, &r);
		if (fabsf(r.freq_hz - f) > worst_f) {
			worst_f = fabsf(r.freq_hz - f);
		}
		if (fabsf(r.amp - 0.8f) / 0.8f > worst_a) {
			worst_a = fabsf(r.amp - 0.8f) / 0.8f;
		}
	}
	zassert_true(worst_f < 0.06f, "worst frequency error %.3f Hz (bin = %.3f Hz)",
		     (double)worst_f, (double)(FS / VIB_N));
	zassert_true(worst_a < 0.02f, "worst amplitude error %.1f%%", (double)(100.0f * worst_a));
}

ZTEST(vib_fft_2_analysis, test_two_tones_strong_25_hz_weak_60_hz)
{
	struct vib_result r;

	clear_block();
	add_sine(1, 25.0f, 1.0f, FS, 0);
	add_sine(1, 60.0f, 0.3f, FS, 0);
	vib_fft_analyse(axes, VIB_N, FS, 2.0f, 0.05f, &r);
	zassert_true(fabsf(r.freq_hz - 25.0f) < 0.06f, "picks %.2f Hz", (double)r.freq_hz);
}

ZTEST(vib_fft_2_analysis, test_two_tones_strong_60_hz_weak_25_hz)
{
	struct vib_result r;

	clear_block();
	add_sine(1, 25.0f, 0.3f, FS, 0);
	add_sine(1, 60.0f, 1.0f, FS, 0);
	vib_fft_analyse(axes, VIB_N, FS, 2.0f, 0.05f, &r);
	zassert_true(fabsf(r.freq_hz - 60.0f) < 0.06f, "picks %.2f Hz", (double)r.freq_hz);
}

ZTEST(vib_fft_2_analysis, test_diagonal_vibration_amplitude_is_the_vector_length)
{
	struct vib_result r;

	clear_block();
	add_sine(0, 40.0f, 0.5f, FS, 0);
	add_sine(1, 40.0f, 0.5f, FS, 0);
	vib_fft_analyse(axes, VIB_N, FS, 2.0f, 0.05f, &r);
	zassert_true(fabsf(r.amp - 0.5f * sqrtf(2.0f)) < 0.015f, "amp %.3f, expected %.3f",
		     (double)r.amp, (double)(0.5f * sqrtf(2.0f)));
}

ZTEST(vib_fft_2_analysis, test_rms_of_a_1_0_sine_is_0p707)
{
	struct vib_result r;

	clear_block();
	add_sine(2, 50.0f, 1.0f, FS, 0);
	vib_fft_analyse(axes, VIB_N, FS, 2.0f, 0.05f, &r);
	zassert_true(fabsf(r.rms - 0.7071f) < 0.01f, "rms %.4f", (double)r.rms);
}

ZTEST(vib_fft_2_analysis, test_sensor_like_noise_only_counts_as_still)
{
	struct vib_result r;

	seed(1);
	clear_block();
	add_noise(0.01f);
	vib_fft_analyse(axes, VIB_N, FS, 2.0f, 0.05f, &r);
	zassert_false(r.active, "should be still");
	zassert_true(r.rms < 0.05f, "rms %.4f", (double)r.rms);
}

ZTEST(vib_fft_2_analysis, test_30_hz_buried_in_noise_on_every_axis)
{
	struct vib_result r;

	seed(2);
	clear_block();
	add_sine(0, 30.0f, 0.2f, FS, 0);
	add_noise(0.1f);
	vib_fft_analyse(axes, VIB_N, FS, 2.0f, 0.05f, &r);
	zassert_true(fabsf(r.freq_hz - 30.0f) < 0.1f, "freq %.2f Hz", (double)r.freq_hz);
	zassert_true(r.active);
}

ZTEST(vib_fft_2_analysis, test_slow_tilting_below_2_hz_is_ignored)
{
	struct vib_result r;

	clear_block();
	add_sine(2, 0.3f, 2.0f, FS, 0);
	add_sine(0, 30.0f, 0.2f, FS, 0);
	vib_fft_analyse(axes, VIB_N, FS, 2.0f, 0.05f, &r);
	zassert_true(fabsf(r.freq_hz - 30.0f) < 0.06f, "freq %.2f Hz", (double)r.freq_hz);
}

ZTEST(vib_fft_2_analysis, test_measured_sample_rate_is_what_makes_50_hz_read_50_hz)
{
	struct vib_result r;
	const float fs_real = 399.6f;                       /* what a 2.5 ms timer really gives */

	clear_block();
	add_sine(1, 50.0f, 0.5f, fs_real, 0);
	vib_fft_analyse(axes, VIB_N, fs_real, 2.0f, 0.05f, &r);
	zassert_true(fabsf(r.freq_hz - 50.0f) < 0.05f, "freq %.3f Hz", (double)r.freq_hz);
	vib_fft_analyse(axes, VIB_N, 400.0f, 2.0f, 0.05f, &r);
	zassert_true(fabsf(r.freq_hz - 50.0f) > 0.04f, "assuming 400 Hz would be off: %.3f Hz",
		     (double)r.freq_hz);
}

ZTEST(vib_fft_2_analysis, test_bad_arguments_are_refused)
{
	struct vib_result r;

	clear_block();
	zassert_equal(vib_fft_analyse(axes, 256, FS, 2.0f, 0.05f, &r), VIB_ERR_ARG,
		      "wrong block length");
	zassert_equal(vib_fft_analyse(axes, VIB_N, 0.0f, 2.0f, 0.05f, &r), VIB_ERR_ARG,
		      "zero sample rate");
	zassert_equal(vib_fft_analyse(axes, VIB_N, FS, 500.0f, 0.05f, &r), VIB_ERR_ARG,
		      "minimum frequency above Nyquist");
}
```
