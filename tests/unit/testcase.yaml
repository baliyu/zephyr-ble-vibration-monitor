## tests/unit/testcase.yaml
```yaml
common:
  tags: unit vibration
tests:
  vibration.unit:
    platform_allow:
      - native_sim/native/64
    integration_platforms:
      - native_sim/native/64
```
